#include "lism.dtsi"

&transform_42keymap {
    col-offset = <5>;
};

&transform_40keymap {
    col-offset = <5>;
};

/* --- 20260221以下を自分で追記（エラー回避） --- */
/ {
    aliases {
        led-red = &led0;
        led-green = &led2;
        led-blue = &led1;
    };
};
